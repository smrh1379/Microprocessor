AHB1RCC 		EQU 0X40023830
GPIOA_MODDER 	EQU 0X40020000
GPIOA_IDR 		EQU 0X40020010
GPIOA_ODR 		EQU 0X40020014
GPIOB_MODDER 	EQU 0x40020400
GPIOB_IDR 		EQU 0x40020410
GPIOB_ODR 		EQU 0x40020414
GPIOB_SRR 		EQU 0x40020418
GPIOC_MODDER	EQU 0x40020800
GPIOC_ODR		EQU 0X40020814
	EXPORT SystemInit
	EXPORT __main
	AREA Mycode,CODE,READONLY

SystemInit FUNCTION
		LDR R0,=AHB1RCC
		MOV R1,0X07
		STR R1,[R0]
		LDR R0,=GPIOA_MODDER
		MOV R1,0X55555555
		STR R1,[R0]
		LDR R0,=GPIOB_MODDER
		MOV R1,0x55000000
		STR R1,[R0]
		LDR R0,=GPIOC_MODDER
		MOV R1,0X55555555
		STR R1,[R0]
		
	ENDFUNC
	
	
	
	
	
	
__main FUNCTION
START
	MOV R6,#0
	LDR R0,=GPIOA_ODR
	MOV R1,#0xFFFF
	STR R1,[R0]
	
	LDR R1,=GPIOB_IDR
	LDR R2,[R1]
	MOV R7,0xF000
	LDR R12 ,=GPIOC_ODR
	STR R7,[R12]
	AND R5,R2,0x00000001
	CMP R5,#1
	BNE RESET
	B START
RESET
	
	LDR R0,=GPIOA_ODR
	MOV R1,#0x0000
	STR R1,[R0]
	MOV R7,0x0000
	LDR R12 ,=GPIOC_ODR
	STR R7,[R12]	
CHECK
;KP FIRST ROW
	LDR R1,=GPIOB_ODR
	MOV R2,0xEFFF
	STR R2,[R1]
	
	LDR R1,=GPIOB_IDR
	LDR R0,[R1]
	;ONE
	MOV R1,0xFEFF
	ORR R2,R1,R0
	CMP R2,R1
	BEQ ONE
	;TWO
	MOV R1,0xFDFF
	ORR R2,R1,R0
	CMP R2,R1
	BEQ TWO
	;3
	MOV R1,0xFBFF
	ORR R2,R1,R0
	CMP R2,R1
	BEQ THREE	
;KP SECOND ROW
	LDR R1,=GPIOB_ODR
	MOV R2,0xDFFF
	STR R2,[R1]
	
	LDR R1,=GPIOB_IDR
	LDR R0,[R1]
	;4
	MOV R1,0xFEFF
	ORR R2,R1,R0
	CMP R2,R1
	BEQ FOUR
	;5
	MOV R1,0xFDFF
	ORR R2,R1,R0
	CMP R2,R1
	BEQ FIVE
	;6
	MOV R1,0xFBFF
	ORR R2,R1,R0
	CMP R2,R1
	BEQ SIX	
;KP THIRD ROW
	LDR R1,=GPIOB_ODR
	MOV R2,0xBFFF
	STR R2,[R1]
	
	LDR R1,=GPIOB_IDR
	LDR R0,[R1]
	;4
	MOV R1,0xFEFF
	ORR R2,R1,R0
	CMP R2,R1
	BEQ SEVEN
	;5
	MOV R1,0xFDFF
	ORR R2,R1,R0
	CMP R2,R1
	BEQ EIGHT
	;6
	MOV R1,0xFBFF
	ORR R2,R1,R0
	CMP R2,R1
	BEQ.W NINE	
	B CHECK	
ONE 
	LDR R1,=GPIOA_ODR
	MOV R2,0x1000 
	MOV R4,R2
	CMP R6,#1
	BEQ.W SHIFTER
	STR R2,[R1]
	MOV R5,0x8000
	LDR R12 ,=GPIOC_ODR
	STR R5,[R12]	
	MOV R6,#1	
	B DELAY
	
TWO
	LDR R1,=GPIOA_ODR
	MOV R2,0x2000
	MOV R4,R2
	CMP R6,#1
	BEQ.W SHIFTER
	STR R2,[R1]
	MOV R5,0x8000
	LDR R12 ,=GPIOC_ODR
	STR R5,[R12]	
	MOV R6,#1		
	B DELAY	
THREE
	LDR R1,=GPIOA_ODR
	MOV R2,0x3000
	MOV R4,R2
	CMP R6,#1
	BEQ SHIFTER	
	STR R2,[R1]
	MOV R5,0x8000
	LDR R12 ,=GPIOC_ODR
	STR R5,[R12]	
	MOV R6,#1	
	B DELAY	
FOUR 
	LDR R1,=GPIOA_ODR
	MOV R2,0x4000
	MOV R4,R2
	CMP R6,#1
	BEQ SHIFTER	
	STR R2,[R1]
	MOV R5,0x8000
	LDR R12 ,=GPIOC_ODR
	STR R5,[R12]	
	MOV R6,#1	
	B DELAY
FIVE
	LDR R1,=GPIOA_ODR
	MOV R2,0x5000
	MOV R4,R2
	CMP R6,#1
	BEQ SHIFTER	
	STR R2,[R1]
	MOV R5,0x8000
	LDR R12 ,=GPIOC_ODR
	STR R5,[R12]	
	MOV R6,#1	
	B DELAY	
SIX
	LDR R1,=GPIOA_ODR
	MOV R2,0x6000
	MOV R4,R2
	CMP R6,#1
	BEQ SHIFTER
	STR R2,[R1]
	MOV R5,0x8000
	LDR R12 ,=GPIOC_ODR
	STR R5,[R12]
	MOV R6,#1
	
	B DELAY	
SEVEN 
	LDR R1,=GPIOA_ODR
	MOV R2,0x7000
	MOV R4,R2
	CMP R6,#1
	BEQ SHIFTER
	STR R2,[R1]
	MOV R5,0x8000
	LDR R12 ,=GPIOC_ODR
	STR R5,[R12]	
	MOV R6,#1

	B DELAY
EIGHT
	LDR R1,=GPIOA_ODR
	MOV R2,0x8000
	MOV R4,R2
	CMP R6,#1
	BEQ SHIFTER	
	STR R2,[R1]	
	MOV R5,0x8000
	LDR R12 ,=GPIOC_ODR
	MOV R6,#1

	STR R5,[R12]	
	B DELAY	
NINE
	LDR R1,=GPIOA_ODR
	MOV R2,0x9000
	MOV R4,R2
	CMP R6,#1
	BEQ SHIFTER	
	STR R2,[R1]	
	MOV R5,0x8000
	LDR R12 ,=GPIOC_ODR
	STR R5,[R12]
	MOV R6,#1
	
	B DELAY		
DELAY
	LDR R7,=0x3FFFFF
L1	SUB R7,#1
	CMP R7,0
	BNE L1
	CMP R6,#1
	MOVEQ R8,R4
	B CHECK
SHIFTER
	MOV R9,R4
	LSR R4,#4
	ORR R4,R4,R8
	LDR R1,=GPIOA_ODR
	STR R4,[R1]
	LDR R1,=GPIOC_ODR
	STR R5,[R1]
	CMP R9,R8
	BGT UP
	BLT DOWN
	BEQ START
UP
	SUB R3,R9,R8
	MOV R4,R8
	LDR R1,=GPIOA_ODR
	STR R4,[R1]
	MOV R10,#4
	MOV R11,0x1000
FOR
	ADD R8,R11
	LSR R12,R8,R10
	ORR R4,R4,R12
	LDR R1,=GPIOA_ODR
	STR R4,[R1]
	LDR R1,=GPIOC_ODR
	LSR R5,#1
	STR R5,[R1]
	LDR R7,=0x3FFFFF
DLY	SUB R7,#1
	CMP R7,0
	BNE DLY
	ADD R10,#4
	CMP R10,16
	MOVEQ R10,#0
	MOVEQ R4,#0
	MOVEQ R5,0x10000
	
	SUB R3,R11
	CMP R3,0
	BGT FOR
	B HERE

DOWN
	SUB R3,R8,R9
	MOV R4,R8
	LDR R1,=GPIOA_ODR
	STR R4,[R1]
	MOV R10,#4
	MOV R11,0x1000
FOR1
	SUB R8,R11
	LSR R12,R8,R10
	ORR R4,R4,R12
	LDR R1,=GPIOA_ODR
	STR R4,[R1]
	LDR R1,=GPIOC_ODR
	LSR R5,#1
	STR R5,[R1]
	LDR R7,=0x3FFFFF
DLY1	SUB R7,#1
	CMP R7,0
	BNE DLY1
	ADD R10,#4
	CMP R10,16
	MOVEQ R10,#0
	MOVEQ R4,#0
	MOVEQ R5,0x10000
	SUB R3,R11
	CMP R3,0
	BGT FOR1

HERE B HERE
	END
		
